## firmware/gateway/components/brand_profile/Kconfig.projbuild
```kconfig
menu "Brand profile (white-label)"

    choice BRAND_PROFILE
        prompt "Brand profile"
        default BRAND_PROFILE_IIOT_KIT
        help
            White-label profile compiled into the firmware.

            Every profile owns a directory under
            components/brand_profile/profiles/<id>/ with its versioned assets
            (logo and manifest). Switching the profile never forks the source
            tree: the same code produces a different visual identity and a
            different product name.

            Adding a profile means adding a choice entry, the matching
            profiles/<id>/ directory and the Kconfig defaults below.

        config BRAND_PROFILE_IIOT_KIT
            bool "IIoT-Kit (reference)"

        config BRAND_PROFILE_ACME_INDUSTRIAL
            bool "Acme Industrial (example customer)"

    endchoice

    config BRAND_NAME
        string "Brand name"
        default "IIoT-Kit" if BRAND_PROFILE_IIOT_KIT
        default "Acme Industrial" if BRAND_PROFILE_ACME_INDUSTRIAL
        help
            Public identity shown on the LCD, in the REST API and in the logs.
            Not a secret. Keep it short: the LCD line is limited to the
            character budget of the boot splash.

    config BRAND_MODEL
        string "Product model"
        default "GW-S3-1" if BRAND_PROFILE_IIOT_KIT
        default "AX-200" if BRAND_PROFILE_ACME_INDUSTRIAL
        help
            Commercial model of the product. Shown next to the brand name in
            the API, the logs and the boot splash.

    config BRAND_SUPPORT_URL
        string "Support URL"
        default "https://example.org/iiot-kit/support" if BRAND_PROFILE_IIOT_KIT
        default "https://support.acme.example" if BRAND_PROFILE_ACME_INDUSTRIAL
        help
            Public support address shown in the API and in the LCD status
            screen. Must start with http:// or https://.

    config BRAND_AP_SSID
        string "Initial soft-AP SSID"
        default "IIoT-Kit-GW" if BRAND_PROFILE_IIOT_KIT
        default "Acme-AX200" if BRAND_PROFILE_ACME_INDUSTRIAL
        help
            SSID advertised by the gateway soft-AP when no manufacturing
            override is injected. Maximum 32 octets (IEEE 802.11).

            This is public configuration, not a secret. The AP password is a
            manufacturing secret and never lives here.

    config BRAND_OTA_CHANNEL
        string "OTA channel"
        default "stable" if BRAND_PROFILE_IIOT_KIT
        default "beta" if BRAND_PROFILE_ACME_INDUSTRIAL
        help
            OTA release channel this build belongs to. Used to route updates
            and to label the artifact name. Public.

    config BRAND_COLOR_BACKGROUND
        string "Background colour (RRGGBB hex)"
        default "0B1020" if BRAND_PROFILE_IIOT_KIT
        default "101820" if BRAND_PROFILE_ACME_INDUSTRIAL
        help
            Background colour of the brand palette, as 6 hex digits without
            the leading '#'. Public.

    config BRAND_COLOR_FOREGROUND
        string "Foreground colour (RRGGBB hex)"
        default "E8EEF7" if BRAND_PROFILE_IIOT_KIT
        default "FFFFFF" if BRAND_PROFILE_ACME_INDUSTRIAL
        help
            Foreground (text) colour of the brand palette, as 6 hex digits
            without the leading '#'. Public.

    config BRAND_COLOR_ACCENT
        string "Accent colour (RRGGBB hex)"
        default "2E8BFF" if BRAND_PROFILE_IIOT_KIT
        default "FF7A00" if BRAND_PROFILE_ACME_INDUSTRIAL
        help
            Accent colour of the brand palette, as 6 hex digits without the
            leading '#'. Public.

    config BRAND_ASSET_BUDGET_BYTES
        int "Flash budget for the brand assets (bytes)"
        default 32768
        range 4096 262144
        help
            Maximum number of bytes the brand assets (logo plus the font
            allowance) may occupy in the application image.

            The build fails when the assets of the selected profile exceed
            this budget, so an oversized logo can never reach a device.

    config BRAND_FONT_RESERVE_BYTES
        int "Flash reserved for the brand font (bytes)"
        default 16384
        range 0 262144
        help
            Bytes reserved inside CONFIG_BRAND_ASSET_BUDGET_BYTES for the
            brand font. The font itself is not embedded yet: LVGL is still
            contract-only (issue #10). The reservation is counted against the
            budget so a future font has a known allowance.

    config BRAND_FIRMWARE_VERSION
        string "Firmware version"
        default "1.0.0"
        help
            Version of this firmware build. Single source of truth: the build
            copies it into the ESP-IDF application descriptor, so the image
            and the reported version cannot drift apart.

            Public. Bump it on every release.

endmenu
```

## firmware/gateway/components/sparkplug_b/Kconfig
```kconfig
# Sparkplug B (gateway as EoN-Node)
#
# Issue #11: MQTT Sparkplug B as an optional MQTT mode.
# Reference: docs/replanificacion/01-decisiones-corregidas.md (DC-13),
#            docs/replanificacion/02-protocolo-unificado.md,
#            odd/tasks/issue-11-sparkplug-b/design.md

menu "Sparkplug B (MQTT v3, EoN-Node mode)"

    config SPARKPLUG_B_ENABLED
        bool "Enable Sparkplug B v3.0.0 publishing on the gateway"
        default n
        help
            When enabled, the gateway connects to an MQTT broker as a Sparkplug B
            v3.0.0 Edge of Network (EoN) Node, representing each ESP-NOW sensor
            node as a Device. Birth / Data / Death certificates, LWT, and the
            seq / bdSeq state machine are owned by the sparkplug_b component.

            When disabled (default), mqtt_bridge_start() stays a no-op and the
            gateway does not open any MQTT client. The Fase 4 placeholder
            behaviour is preserved.

    config SPARKPLUG_B_GROUP_ID_DEFAULT
        string "Default Sparkplug group_id (used when NVS key mqtt_group_id is unset)"
        default "iiot-kit"
        depends on SPARKPLUG_B_ENABLED
        help
            Maps to {group_id} in the Sparkplug topic namespace
            spBv1.0/{group_id}/{msg_type}/{edge_node_id}[/{device_id}].
            Override per-installation via NVS without recompiling.

    config SPARKPLUG_B_EDGE_NODE_ID_PREFIX
        string "Default edge_node_id prefix (gateway MAC suffix is appended if NVS is unset)"
        default "GW"
        depends on SPARKPLUG_B_ENABLED
        help
            The full edge_node_id becomes <prefix>-<last 4 hex of MAC>, e.g.
            GW-A1B2C3D4. Override via NVS key mqtt_edge_node_id.

    config SPARKPLUG_B_DEVICE_ID_PREFIX
        string "Default device_id prefix (sensor node MAC suffix is appended)"
        default "N"
        depends on SPARKPLUG_B_ENABLED
        help
            The full device_id becomes <prefix>-<last 4 hex of node MAC>, e.g.
            N-7F8E9D10. The prefix follows the Sparkplug 3.0.0 recommendation
            to keep device ids opaque identifiers.

    config SPARKPLUG_B_DDEATH_TIMEOUT_SEC
        int "DDEATH expiry timeout (seconds, per device)"
        default 1800
        range 60 86400
        depends on SPARKPLUG_B_ENABLED
        help
            If no MSG_TYPE_DATA arrives from a sensor node for this many seconds,
            the gateway publishes DDEATH for that device. Default 1800 s = 30 min,
            aligned with the typical deep-sleep interval plus margin. Override
            via NVS key mqtt_ddeath_timeout_sec.

    config SPARKPLUG_B_KEEPALIVE_SEC
        int "MQTT keepalive (seconds)"
        default 60
        range 15 600
        depends on SPARKPLUG_B_ENABLED

    config SPARKPLUG_B_TLS_ENABLED_DEFAULT
        bool "Default to TLS on first boot when NVS key mqtt_tls is unset"
        default n
        depends on SPARKPLUG_B_ENABLED
        help
            Recommend OFF for local brokers (mosquitto on the LAN) and ON for
            cloud / public brokers. Override per-installation via NVS
            mqtt_tls without recompiling.

    config SPARKPLUG_B_TLS_CA_PATH
        string "SPIFFS path to the CA bundle (PEM, single or concatenated)"
        default "/spiffs/mqtt/ca.pem"
        depends on SPARKPLUG_B_ENABLED

    config SPARKPLUG_B_TLS_CLIENT_CERT_PATH
        string "SPIFFS path to the client certificate (PEM, mTLS only)"
        default "/spiffs/mqtt/cert.pem"
        depends on SPARKPLUG_B_ENABLED

    config SPARKPLUG_B_TLS_CLIENT_KEY_PATH
        string "SPIFFS path to the client private key (PEM, mTLS only)"
        default "/spiffs/mqtt/key.pem"
        depends on SPARKPLUG_B_ENABLED

endmenu
```

## firmware/gateway/components/wifi_manager/Kconfig.projbuild
```kconfig
menu "Wi-Fi Manager"

    config WIFI_MANAGER_AP_DEFAULT_SSID
        string "Default soft-AP SSID"
        default "IIoT-Gateway"
        help
            SSID advertised by the gateway when the caller leaves the field empty.
            This is the documented Fase 0 T0.6.1 value; do NOT use this field for
            any production secret.

    config WIFI_MANAGER_AP_DEFAULT_PASSWORD
        string "Default soft-AP password"
        default ""
        help
            Optional fallback password. Empty means the soft-AP will start in
            open mode. Real deployments must inject a password through the
            gitignored `wifi_credentials.local.h` header, not through Kconfig.

    config WIFI_MANAGER_AP_DEFAULT_CHANNEL
        int "Default soft-AP channel"
        range 1 13
        default 1
        help
            Phase 0 default channel. ESP-NOW + AP coexistence will be addressed
            later (T0.6.3) and may force a router-selected channel.

    config WIFI_MANAGER_AP_DEFAULT_MAX_CONN
        int "Default soft-AP maximum clients"
        range 1 10
        default 4

endmenu
```

## firmware/gateway/test/main/Kconfig
```kconfig
menu "Gateway test application"

choice GATEWAY_TEST_PROFILE
    prompt "Test profile"
    default GATEWAY_TEST_PROFILE_BOARD
    help
        Which set of tests the application runs.

        The "board" profile runs every test, including the ones that need the
        real hardware (the Octal PSRAM of the N16R8, the RMT of the RGB LED,
        the radio). This is the profile that runs on the physical gateway.

        The "logic" profile skips the tests tagged [hw]. It is the profile the
        CI uses under QEMU, where the Octal PSRAM is not emulated and the
        chip would abort before the first test.

    config GATEWAY_TEST_PROFILE_BOARD
        bool "Board: every test, needs the real hardware"

    config GATEWAY_TEST_PROFILE_LOGIC
        bool "Logic: every test except the ones tagged [hw]"
endchoice

endmenu
```

## tools/lcd-smoke/main/Kconfig.projbuild
```kconfig
menu "ST7789 image diagnostic"

    config LCD_SMOKE_X_GAP
        int "Panel X gap (pixels)"
        range 0 240
        default 35
        help
            Column offset of the visible area inside the controller RAM.
            35 is the offset commonly used with the 170x320 ST7789
            modules. It is a provisional software tuning, not a verified
            fact about the panel in hand.

    config LCD_SMOKE_Y_GAP
        int "Panel Y gap (pixels)"
        range 0 320
        default 0
        help
            Row offset of the visible area inside the controller RAM.
            Provisional software tuning, not a verified panel fact.

    config LCD_SMOKE_INVERT_COLOR
        bool "Invert the colours of the panel"
        default y
        help
            Sends the INVON command after the panel initialisation. Whether
            the panel in hand needs it is unknown: the value is a
            provisional software tuning, and the diagnostic exists to find
            out which tuning the panel answers to.

    choice LCD_SMOKE_COLOR_ORDER
        prompt "Panel colour element order"
        default LCD_SMOKE_COLOR_ORDER_RGB
        help
            The RGB or BGR bit of the MADCTL command. Provisional software
            tuning: the marking of the panel carries a "B" suffix, but a
            marking is not a verified statement about the colour order.

        config LCD_SMOKE_COLOR_ORDER_RGB
            bool "RGB"

        config LCD_SMOKE_COLOR_ORDER_BGR
            bool "BGR"
    endchoice

endmenu
```
